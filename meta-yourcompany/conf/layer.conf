## meta-yourcompany/conf/layer.conf
```bitbake
# We have a conf and classes directory, add to BBPATH
BBPATH .= ":${LAYERDIR}"

# We have recipes-* directories, add to BBFILES
BBFILES += "${LAYERDIR}/recipes-*/*/*.bb \
            ${LAYERDIR}/recipes-*/*/*.bbappend"

BBFILE_COLLECTIONS += "meta-yourcompany"
BBFILE_PATTERN_meta-yourcompany = "^${LAYERDIR}/"
BBFILE_PRIORITY_meta-yourcompany = "6"

LAYERDEPENDS_meta-yourcompany = "core"
LAYERSERIES_COMPAT_meta-yourcompany = "walnascar"
```

## meta-yourcompany/meta-yourmachine/conf/layer.conf
```bitbake
# We have a conf and classes directory, add to BBPATH
BBPATH .= ":${LAYERDIR}"

# We have recipes-* directories, add to BBFILES
BBFILES += "${LAYERDIR}/recipes-*/*/*.bb \
            ${LAYERDIR}/recipes-*/*/*.bbappend"

BBFILE_COLLECTIONS += "meta-yourmachine"
BBFILE_PATTERN_meta-yourmachine = "^${LAYERDIR}/"
BBFILE_PRIORITY_meta-yourmachine = "6"

LAYERDEPENDS_meta-yourmachine = "core"
LAYERSERIES_COMPAT_meta-yourmachine = "walnascar"
```
